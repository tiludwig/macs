/*
 *  lcd.c
 *
 *  Created by Michael Köhler on 22.12.16.
 *  Copyright 2016 Skie-Systems. All rights reserved.
 *
 */
/* Standard ASCII 6x8 font */

#include "lcd.h"

#if PSC_I2C != 1 && PSC_I2C != 4 && PSC_I2C != 16 && PSC_I2C != 64
#error "Wrong prescaler for TWI !"
#elif SET_TWBR < 0 || SET_TWBR > 255
#error "TWBR out of range, change PSC_I2C or F_I2C !"
#endif

static const uint8_t ssd1306oled_font6x8 [] PROGMEM = {
    0x00, 0x00, 0x00, 0x00, 0x00, 0x00, // sp
    0x00, 0x00, 0x00, 0x2f, 0x00, 0x00, // !
    0x00, 0x00, 0x07, 0x00, 0x07, 0x00, // "
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	0x00, 0x08, 0x04, 0x08, 0x08, 0x04, // ~
};

const uint8_t ssd1306_init_sequence [] PROGMEM = {	// Initialization Sequence
0xAE,			// Display OFF (sleep mode)
0x20, 0b00,		// Set Memory Addressing Mode
				// 00=Horizontal Addressing Mode; 01=Vertical Addressing Mode;
				// 10=Page Addressing Mode (RESET); 11=Invalid
0xB0,			// Set Page Start Address for Page Addressing Mode, 0-7
0xC8,			// Set COM Output Scan Direction
0x00,			// --set low column address
0x10,			// --set high column address
0x40,			// --set start line address
0x81, 0x3F,		// Set contrast control register
0xA1,			// Set Segment Re-map. A0=address mapped; A1=address 127 mapped. 
0xA6,			// Set display mode. A6=Normal; A7=Inverse
0xA8, 0x3F,		// Set multiplex ratio(1 to 64)
0xA4,			// Output RAM to Display
				// 0xA4=Output follows RAM content; 0xA5,Output ignores RAM content
0xD3, 0x00,		// Set display offset. 00 = no offset
0xD5,			// --set display clock divide ratio/oscillator frequency
0xF0,			// --set divide ratio
0xD9, 0x22,		// Set pre-charge period
0xDA, 0x12,		// Set com pins hardware configuration		
0xDB,			// --set vcomh
0x20,			// 0x20,0.77xVcc
0x8D, 0x14,		// Set DC-DC enable
0xAF,			// Display ON in normal mode

};
void i2c_init(void){
	LCD_PORT |= (1 << SDA_Pin)|(1 << SDC_Pin);		// experimental, pullups for 12c_bus
	LCD_PORT_DDR |= (1 << SDA_Pin)|(1 << SDC_Pin);
	// set clock
	switch (PSC_I2C) {
		case 4:
			TWSR = 0x1;
			break;
		case 16:
			TWSR = 0x2;
			break;
		case 64:
			TWSR = 0x3;
			break;
		default:
			TWSR = 0x00;
			break;
	}
	TWBR = (uint8_t)SET_TWBR;
	// enable
	TWCR = (1 << TWEN);
}
void lcd_send_i2c_start(void){
    // i2c start
    TWCR = (1 << TWINT)|(1 << TWSTA)|(1 << TWEN);
    while((TWCR & (1 << TWINT)) == 0);
    // send adress
    TWDR = LCD_I2C_ADDR;
    TWCR = (1 << TWINT)|( 1 << TWEN);
    while((TWCR & (1 << TWINT)) == 0);
}
void lcd_send_i2c_stop(void){
    // i2c stop
    TWCR = (1 << TWINT)|(1 << TWSTO)|(1 << TWEN);
}
void lcd_send_i2c_byte(uint8_t byte){
    TWDR = byte;
    TWCR = (1 << TWINT)|( 1 << TWEN);
    while((TWCR & (1 << TWINT)) == 0);
}

void lcd_init(uint8_t dispAttr){
	if(LCD_INIT_I2C == YES) i2c_init();
	for (uint8_t i = 0; i < sizeof (ssd1306_init_sequence); i++) {
		lcd_command(pgm_read_byte(&ssd1306_init_sequence[i]));
	}
	lcd_command(dispAttr);
    lcd_clrscr();
}
void lcd_home(void){
	lcd_gotoxy(0, 0);
}

void lcd_command(uint8_t cmd) {
    lcd_send_i2c_start();
    lcd_send_i2c_byte(0x00);	// 0x00 for command, 0x40 for data
    lcd_send_i2c_byte(cmd);
    lcd_send_i2c_stop();
}
void lcd_data(uint8_t data) {
    lcd_send_i2c_start();
    lcd_send_i2c_byte(0x40);	// 0x00 for command, 0x40 for data
    lcd_send_i2c_byte(data);
    lcd_send_i2c_stop();
}
void lcd_gotoxy(uint8_t x, uint8_t y){
	x = x * 6;
    lcd_send_i2c_start();		// start i2c communication
    lcd_send_i2c_byte(0x00);	// 0x00 for command, 0x40 for data
    lcd_send_i2c_byte(0xb0 + y);// set page start to y
	lcd_send_i2c_byte(0x21);	// set column start	
    lcd_send_i2c_byte(x);		// to x
	lcd_send_i2c_byte(0x7f);	// set column end to 127
    lcd_send_i2c_stop();		// stop i2c communication
}
void lcd_clrscr(void){
    lcd_home();
	lcd_send_i2c_start();
    lcd_send_i2c_byte(0x40);	// 0x00 for command, 0x40 for data
    for (uint16_t i = 0; i < 128 * 8 ; i++) {
        lcd_send_i2c_byte(0);	// clear display while printing space
    }
    lcd_send_i2c_stop();
	lcd_home();
}
void lcd_putc(char c){
    uint8_t ch = c - 32;
    lcd_send_i2c_start();
    lcd_send_i2c_byte(0x40);	// 0x00 for command, 0x40 for data
    for (uint8_t i = 0; i < 6; i++)
	{
		lcd_send_i2c_byte(pgm_read_byte(&ssd1306oled_font6x8[ch * 6 + i]));	// print font to ram, print 6 columns
	}
    lcd_send_i2c_stop();
}
void lcd_puts(const char* s){
    while (*s) {
        lcd_putc(*s++);
    }
}
void lcd_puts_p(const char* progmem_s){
    register uint8_t c;
    while ((c = pgm_read_byte(progmem_s++))) {
        lcd_putc(c);
    }
}
void lcd_invert(uint8_t invert){
    lcd_send_i2c_start();
    lcd_send_i2c_byte(0x00);	// 0x00 for command, 0x40 for data
    if (invert == YES) {
        lcd_send_i2c_byte(0xA7);
    } else {
        lcd_send_i2c_byte(0xA6);
    }
    lcd_send_i2c_stop();
}
void lcd_set_contrast(uint8_t contrast){
    lcd_send_i2c_start();
    lcd_send_i2c_byte(0x00);	// 0x00 for command, 0x40 for data
    lcd_send_i2c_byte(0x81);
    lcd_send_i2c_byte(contrast);
    lcd_send_i2c_stop();
}
